## conf/layer.conf
```bitbake
BBPATH .= ":${LAYERDIR}"
BBFILES += "${LAYERDIR}/recipes*/*/*.bb ${LAYERDIR}/recipes*/*/*.bbappend"
BBFILE_COLLECTIONS += "freshbs-hybris-layer"
BBFILE_PATTERN_freshbs-hybris-layer := "^${LAYERDIR}/"
BBFILE_PRIORITY_freshbs-hybris-layer = "7"
LAYERSERIES_COMPAT_freshbs-hybris-layer = "honister"
```
